## lxc_c_app/out/yp/conf/bblayers.conf
```bitbake
# LAYER_CONF_VERSION is increased each time build/conf/bblayers.conf
# changes incompatibly
LCONF_VERSION = "6"

BBPATH = "${TOPDIR}"
BBFILES ?= ""

BBLAYERS ?= " \
  /opt/iox-sdk/sys/yocto-1.7/poky-dizzy-12.0.2/meta-cisco-iox-base \
  /opt/iox-sdk/sys/yocto-1.7/ir800/meta-cisco-ir800 \
  /opt/iox-sdk/sys/yocto-1.7/poky-dizzy-12.0.2/meta \
  /opt/iox-sdk/sys/yocto-1.7/poky-dizzy-12.0.2/meta-yocto \
  /opt/iox-sdk/sys/yocto-1.7/poky-dizzy-12.0.2/meta-yocto-bsp \
  /home/nathan/git/oe-core/meta \
  /home/nathan/git/meta-openembedded/meta-networking \
  /home/nathan/git/meta-openembedded/meta-python \
  /home/nathan/git/meta-openembedded/meta-oe \
  "
BBLAYERS_NON_REMOVABLE ?= " \
  /opt/iox-sdk/sys/yocto-1.7/poky-dizzy-12.0.2/meta \
  /opt/iox-sdk/sys/yocto-1.7/poky-dizzy-12.0.2/meta-yocto \
  "
```
